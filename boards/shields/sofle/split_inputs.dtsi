#include <input/processors.dtsi>
#include <dt-bindings/zmk/input_transform.h>
// #include <behaviors/input_gestures_accel.dtsi>
#include <behaviors/input_processor_gestures.dtsi>
#include <behaviors/input_processor_absolute_to_relative.dtsi>

// &pointer_accel {
//     // https://github.com/oleksandrmaslov/zmk-pointing-acceleration
    
//     input-type = <INPUT_EV_REL>;  // For relative input devices
//     track-remainders;             // Accumulate fractional movements
//     min-factor = <1000>;          // 0.8x at very slow speeds
//     max-factor = <20000>;         // 3.0x at fast speeds
//     speed-threshold = <100>;     // counts/sec for 1x
//     speed-max = <500>;          // 6000 counts/sec for max accel
//     acceleration-exponent = <2>;  // Quadratic acceleration curve
// };

/ {
    split_inputs {
        #address-cells = <1>;
        #size-cells = <0>;

        glidepoint_split: glidepoint_split@2 {
            compatible = "zmk,input-split";
            reg = <2>;
        };
    };

    glidepoint_listener: glidepoint_listener {
        compatible = "zmk,input-listener";
        status = "disabled";
        device = <&glidepoint_split>;
    };
};