## boards/shields/sofle/Kconfig.defconfig
```kconfig
if SHIELD_SOFLE_LEFT || SHIELD_SOFLE_DONGLE_PRO_MICRO

config ZMK_KEYBOARD_NAME
    default "Sofle"

config ZMK_SPLIT_ROLE_CENTRAL
    default y

config ZMK_SPLIT_BLE_CENTRAL_PERIPHERALS
    default 2

config BT_MAX_CONN
    default 5

config ZMK_POINTING
    default y

config I2C
    default y

config SSD1306
    default y

endif ##SHIELD_SOFLE_DONGLE_PRO_MICRO



if SHIELD_SOFLE_RIGHT_PERIPHERAL

config I2C
    default y

config SSD1306
    default y

config ZMK_POINTING
    default y

endif



if SHIELD_SOFLE_LEFT_PERIPHERAL

config I2C
    default y

config SSD1306
    default y

endif



if SHIELD_SOFLE_LEFT || SHIELD_SOFLE_RIGHT_PERIPHERAL || SHIELD_SOFLE_LEFT_PERIPHERAL || SHIELD_SOFLE_DONGLE_PRO_MICRO

config ZMK_SPLIT
    default y

endif ##SHIELD_SOFLE_LEFT || SHIELD_SOFLE_RIGHT_PERIPHERAL || SHIELD_SOFLE_LEFT_PERIPHERAL || SHIELD_SOFLE_DONGLE_PRO_MICRO
```
